/ {
    kscan0: kscan {
        compatible = "zmk,kscan-gpio-matrix";

        diode-direction = "col2row";

        row-gpios = <
            &gpio0 2 GPIO_ACTIVE_LOW
            &gpio0 3 GPIO_ACTIVE_LOW
            &gpio0 4 GPIO_ACTIVE_LOW
            &gpio0 5 GPIO_ACTIVE_LOW
            &gpio0 6 GPIO_ACTIVE_LOW
        >;

        col-gpios = <
            &gpio1 6 GPIO_ACTIVE_LOW
            &gpio1 5 GPIO_ACTIVE_LOW
            &gpio1 4 GPIO_ACTIVE_LOW
            &gpio1 3 GPIO_ACTIVE_LOW
            &gpio1 2 GPIO_ACTIVE_LOW
            &gpio1 1 GPIO_ACTIVE_LOW
            &gpio1 0 GPIO_ACTIVE_LOW
            &gpio0 15 GPIO_ACTIVE_LOW
            &gpio0 14 GPIO_ACTIVE_LOW
            &gpio0 13 GPIO_ACTIVE_LOW
            &gpio0 12 GPIO_ACTIVE_LOW
            &gpio0 11 GPIO_ACTIVE_LOW
            &gpio0 10 GPIO_ACTIVE_LOW
            &gpio0 9 GPIO_ACTIVE_LOW
            &gpio0 8 GPIO_ACTIVE_LOW
        >;
    };
};
